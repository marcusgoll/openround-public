## CMakeLists.txt
```
# OpenRound Phase 1 v0 — swing-capture instrument for the Seeed XIAO nRF52840 Sense.
# Build: west build -b xiao_ble/nrf52840/sense <this directory>
cmake_minimum_required(VERSION 3.20.0)

find_package(Zephyr REQUIRED HINTS $ENV{ZEPHYR_BASE})
project(openround_phase1)

target_sources(app PRIVATE src/main.c)
```

## prj.conf
```kconfig
# OpenRound Phase 1 v0 — Seeed XIAO nRF52840 Sense (xiao_ble/nrf52840/sense).
# Symbols checked against Zephyr v4.4.2 sources on 2026-08-20 (see README).

# --- Onboard IMU (LSM6DS3TR-C, driven by the st,lsm6dsl driver) ---
# The board devicetree already models the IMU: node lsm6ds3tr_c@6a on the
# internal &i2c0 (TWIM, 400 kHz), power gated by a regulator-fixed node on
# P1.08 with regulator-boot-on (CONFIG_REGULATOR=y comes from the board
# defconfig), DRDY on P0.11 (irq-gpios). Nothing to add in the overlay.
CONFIG_SENSOR=y
CONFIG_LSM6DSL=y
# FS index: 16 -> +/-16 g (drivers/sensor/st/lsm6dsl/Kconfig)
CONFIG_LSM6DSL_ACCEL_FS=16
# ODR index 8 -> 1666 Hz, the target rate from docs/hardware-review.md.
# The driver's Kconfig table goes up to index 10 (6664 Hz), so the standard
# sensor API does NOT cap us below 1.6 kHz. Indexes 9/10 would outrun the
# 400 kHz I2C fetch path anyway.
CONFIG_LSM6DSL_ACCEL_ODR=8
# CONFIG_LSM6DSL_GYRO_ODR defaults to 0 = "runtime", which the driver init
# writes as ODR register 0 = gyro power-down. We want the gyro off; leave it.
CONFIG_LSM6DSL_TRIGGER_OWN_THREAD=y
CONFIG_LSM6DSL_THREAD_STACK_SIZE=2048
# Sampling thread must outrank the CSV-printing main thread (see below),
# otherwise a stalled USB write would starve sample capture.
CONFIG_LSM6DSL_THREAD_PRIORITY=5

# --- USB CDC-ACM console (the board routes zephyr,console to CDC-ACM) ---
# The XIAO board's Zephyr v4.4.2 backend uses the new USB device stack.
CONFIG_USB_DEVICE_STACK_NEXT=y
CONFIG_USBD_CDC_ACM_CLASS=y
CONFIG_CDC_ACM_SERIAL_INITIALIZE_AT_BOOT=y
CONFIG_CDC_ACM_SERIAL_MANUFACTURER_STRING="OpenRound"
CONFIG_CDC_ACM_SERIAL_PRODUCT_STRING="OpenRound Phase1 Capture"
CONFIG_CDC_ACM_SERIAL_PID=0x0100
CONFIG_UART_CONSOLE=y
# Needed for uart_line_ctrl_get(): main waits for DTR so the T header line
# is not emitted into the void before a terminal is attached.
CONFIG_UART_LINE_CTRL=y
# ~57 KB/s of CSV at 1666 Hz; the matching 4 KiB CDC FIFOs are in app.overlay.

# --- Float formatting for the CSV lines (printk %.3f) ---
CONFIG_CBPRINTF_FP_SUPPORT=y
CONFIG_FPU=y

# --- Minimal logging (driver errors ride the same USB console) ---
CONFIG_LOG=y
CONFIG_LOG_MODE_MINIMAL=y

# Main thread only formats and prints; it must NOT preempt the sampling
# thread (priority 5 above).
CONFIG_MAIN_THREAD_PRIORITY=7
CONFIG_MAIN_STACK_SIZE=2048

# No BLE in v0.
CONFIG_BT=n
```

## app.overlay
```dts
/*
 * OpenRound Phase 1 v0 — application overlay for xiao_ble/nrf52840/sense.
 *
 * The board devicetree (Zephyr v4.4.2,
 * boards/seeed/xiao_ble/) already provides everything v0 needs:
 *
 *   - Console on USB CDC-ACM: xiao_ble_common.dtsi includes
 *     boards/common/usb/cdc_acm_serial.dtsi, which sets
 *     zephyr,console = &board_cdc_acm_uart.
 *   - Onboard IMU: xiao_ble_nrf52840_sense.dts defines lsm6ds3tr_c@6a
 *     (compatible "st,lsm6dsl" — the LSM6DS3TR-C shares the LSM6DSL
 *     register map and WHO_AM_I 0x6A) on the internal &i2c0 TWIM bus at
 *     400 kHz, with DRDY on P0.11.
 *   - IMU power: a regulator-fixed node ("lsm6ds3tr-c-en") drives 6D_PWR
 *     (P1.08) high at boot (regulator-boot-on, 3 ms startup delay). With
 *     CONFIG_REGULATOR=y (board defconfig) no application code touches it.
 */

&board_cdc_acm_uart {
	/* ~57 KB/s of CSV at 1666 Hz; 4 KiB cushions USB scheduling gaps. */
	tx-fifo-size = <4096>;
	rx-fifo-size = <4096>;
};

/*
 * TODO(adxl375): ADXL375 +/-200 g breakout (Adafruit PID 5374, I2C addr
 * 0x53) — wire STEMMA QT SDA/SCL to the XIAO pads D4 (P0.04) / D5 (P0.05),
 * which are &i2c1 (nordic,nrf-twi, already status "okay" in
 * xiao_ble_common.dtsi). 3V3 and GND from the XIAO header.
 *
 * Zephyr v4.4.2 has NO in-tree adi,adxl375 binding or driver (checked
 * 2026-08-20: dts/bindings/sensor/ carries adxl313/345/355/362/366/367/372
 * only). The ADXL375 is the +/-200 g sibling of the ADXL345 with the same
 * register map but a different, fixed sensitivity (~20.5 LSB/g), so
 * pretending it is an "adi,adxl345" would enumerate but report wrongly
 * scaled data — do not do that silently.
 *
 * When the part arrives, in order of preference:
 *   1. Re-check whether current Zephyr gained adi,adxl375 support and use it.
 *   2. Add a small out-of-tree binding + driver (ADXL345 driver with the
 *      375 sensitivity constant) in this app's own module.
 *   3. Phase-1-quality fallback: raw i2c_* register access from main.c
 *      (acceptable for the ADXL375 because there is no in-tree driver;
 *      the onboard LSM6DS3TR-C stays on the standard sensor API).
 *
 * Then uncomment and adapt:
 *
 *   &i2c1 {
 *       status = "okay";
 *       adxl375: adxl375@53 {
 *           compatible = "adi,adxl375";
 *           reg = <0x53>;
 *           status = "okay";
 *       };
 *   };
 */
```

## src/main.c
```c
/*
 * OpenRound Phase 1 v0 — bench swing-capture instrument.
 *
 * Streams the XIAO nRF52840 Sense onboard LSM6DS3TR-C (+/-16 g, 1666 Hz)
 * over USB CDC-ACM as CSV. Line format is the contract with the Python
 * analysis tool — see README.md before changing anything it emits.
 *
 * Data path: LSM6DSL driver DRDY trigger (own thread, prio 5) fetches each
 * sample, timestamps it, runs the threshold check, and enqueues it; the
 * main thread (prio 7) formats and prints. Sampling therefore never blocks
 * on USB — if the host stalls, samples are dropped at the queue and
 * counted, and the drop count is reported on a "D," line.
 */

#include <math.h>
#include <stdint.h>

#include <zephyr/device.h>
#include <zephyr/devicetree.h>
#include <zephyr/drivers/sensor.h>
#include <zephyr/drivers/uart.h>
#include <zephyr/kernel.h>
#include <zephyr/sys/atomic.h>
#include <zephyr/sys/printk.h>

/* Placeholder for the production stage-1 wake threshold (2-3 g band per
 * docs/hardware-review.md, "two-stage wake"). Software-only check in v0. */
#define WAKE_THRESHOLD_G 2.5f
/* Hysteresis: an event ends only when |a| falls back below this, so one
 * swing waving around 2.5 g emits one EVT line, not dozens. */
#define EVENT_END_G      2.0f

#define STANDARD_GRAVITY_MS2 9.80665f

enum msg_kind {
	MSG_SAMPLE,
	MSG_EVENT,
};

struct capture_msg {
	enum msg_kind kind;
	uint64_t t_us;
	float ax_g;
	float ay_g;
	float az_g;
	float peak_g; /* MSG_EVENT only */
};

/* 256 * 32 B = 8 KB: ~150 ms of samples at 1666 Hz to ride out USB stalls. */
K_MSGQ_DEFINE(capture_q, sizeof(struct capture_msg), 256, 4);

static atomic_t dropped_samples;
static atomic_t fetch_errors;

/* k_cycle_get_32() runs at 32768 Hz on nRF52 (RTC-based system timer) and
 * wraps every ~36 h. Extend to 64 bits here; called only from the sensor
 * trigger thread, so the static state needs no locking, and at >1 kHz call
 * rate a wrap can never be missed. Resolution is ~30.5 us — coarser than
 * the 600 us sample period but fine for v0 bench work (see README). */
static uint64_t cycle_count_64(void)
{
	static uint32_t last;
	static uint64_t high;
	uint32_t now = k_cycle_get_32();

	if (now < last) {
		high += UINT64_C(1) << 32;
	}
	last = now;
	return high | now;
}

static void drdy_handler(const struct device *dev,
			 const struct sensor_trigger *trig)
{
	static bool in_event;
	static float peak_g;
	static uint64_t peak_t_us;

	struct sensor_value acc[3];
	struct capture_msg msg;

	ARG_UNUSED(trig);

	if (sensor_sample_fetch_chan(dev, SENSOR_CHAN_ACCEL_XYZ) < 0) {
		atomic_inc(&fetch_errors);
		return;
	}
	/* Timestamp is taken after the I2C read completes: a roughly constant
	 * ~0.2-0.3 ms late offset, irrelevant for relative timing. */
	uint64_t t_us = k_cyc_to_us_floor64(cycle_count_64());

	if (sensor_channel_get(dev, SENSOR_CHAN_ACCEL_XYZ, acc) < 0) {
		atomic_inc(&fetch_errors);
		return;
	}

	float ax_g = (float)sensor_value_to_double(&acc[0]) / STANDARD_GRAVITY_MS2;
	float ay_g = (float)sensor_value_to_double(&acc[1]) / STANDARD_GRAVITY_MS2;
	float az_g = (float)sensor_value_to_double(&acc[2]) / STANDARD_GRAVITY_MS2;
	float mag_g = sqrtf(ax_g * ax_g + ay_g * ay_g + az_g * az_g);

	if (mag_g > WAKE_THRESHOLD_G) {
		if (!in_event || mag_g > peak_g) {
			peak_g = mag_g;
			peak_t_us = t_us;
		}
		in_event = true;
	} else if (in_event && mag_g < EVENT_END_G) {
		in_event = false;
		msg.kind = MSG_EVENT;
		msg.t_us = peak_t_us;
		msg.peak_g = peak_g;
		msg.ax_g = 0.0f;
		msg.ay_g = 0.0f;
		msg.az_g = 0.0f;
		if (k_msgq_put(&capture_q, &msg, K_NO_WAIT) < 0) {
			atomic_inc(&dropped_samples);
		}
	}

	msg.kind = MSG_SAMPLE;
	msg.t_us = t_us;
	msg.ax_g = ax_g;
	msg.ay_g = ay_g;
	msg.az_g = az_g;
	msg.peak_g = 0.0f;
	if (k_msgq_put(&capture_q, &msg, K_NO_WAIT) < 0) {
		atomic_inc(&dropped_samples);
	}
}

int main(void)
{
	const struct device *imu = DEVICE_DT_GET(DT_NODELABEL(lsm6ds3tr_c));
	const struct device *console = DEVICE_DT_GET(DT_CHOSEN(zephyr_console));
	static struct sensor_trigger drdy_trig = {
		.type = SENSOR_TRIG_DATA_READY,
		.chan = SENSOR_CHAN_ACCEL_XYZ,
	};
	long reported_drops = 0;
	long reported_fetch_errors = 0;

	if (!device_is_ready(console)) {
		return 0; /* no USB means no output channel; nothing to report to */
	}

	/* Block until a terminal opens the port (asserts DTR), so the header
	 * lines land in the capture file instead of a dead ring buffer. */
	uint32_t dtr = 0;
	while (dtr == 0) {
		uart_line_ctrl_get(console, UART_LINE_CTRL_DTR, &dtr);
		k_sleep(K_MSEC(100));
	}

	printk("I,openround-phase1-v0,imu=lsm6ds3tr-c,odr_hz=1666,fs_g=16\n");
	printk("T,%.3f\n", (double)WAKE_THRESHOLD_G);

	if (!device_is_ready(imu)) {
		/* Driver init failed (its own log lines predate USB and are
		 * lost); say so on the contract channel and stop. */
		printk("ERR,imu-not-ready\n");
		return 0;
	}

	/* ODR (1666 Hz) and FS (+/-16 g) were applied at driver init from
	 * CONFIG_LSM6DSL_ACCEL_ODR / _FS; this only enables the DRDY path. */
	if (sensor_trigger_set(imu, &drdy_trig, drdy_handler) < 0) {
		printk("ERR,trigger-set-failed\n");
		return 0;
	}

	struct capture_msg msg;
	while (true) {
		if (k_msgq_get(&capture_q, &msg, K_SECONDS(1)) != 0) {
			/* Samples should arrive every 600 us; a silent second
			 * means the IMU path is broken. */
			printk("ERR,no-samples,fetch_errors=%ld\n",
			       atomic_get(&fetch_errors));
			continue;
		}

		switch (msg.kind) {
		case MSG_SAMPLE:
			printk("S,%llu,%.3f,%.3f,%.3f\n",
			       (unsigned long long)msg.t_us, (double)msg.ax_g,
			       (double)msg.ay_g, (double)msg.az_g);
			break;
		case MSG_EVENT:
			printk("EVT,%llu,%.3f\n",
			       (unsigned long long)msg.t_us, (double)msg.peak_g);
			break;
		}

		long drops = atomic_get(&dropped_samples);
		if (drops != reported_drops) {
			reported_drops = drops;
			printk("D,%llu,%ld\n", (unsigned long long)msg.t_us,
			       drops);
		}
		long ferr = atomic_get(&fetch_errors);
		if (ferr != reported_fetch_errors) {
			reported_fetch_errors = ferr;
			printk("ERR,imu-fetch,%ld\n", ferr);
		}
	}
	return 0;
}
```
